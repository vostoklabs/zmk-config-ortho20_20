## boards/shields/ortho20_20/Kconfig.defconfig
```kconfig
if SHIELD_ORTHO20_20_LEFT

# Name must be less than 16 characters long!
config ZMK_KEYBOARD_NAME
    default "ortho20/20"

config ZMK_SPLIT_ROLE_CENTRAL
    default y

config ZMK_SPLIT_BLE_CENTRAL_PERIPHERALS
  default 1

config BT_MAX_CONN
  default 6

config BT_MAX_PAIRED
  default 6

endif

if SHIELD_ORTHO20_20_LEFT || SHIELD_ORTHO20_20_RIGHT

config ZMK_SPLIT
    default y

endif
```

## boards/shields/ortho20_20/Kconfig.shield
```kconfig
config SHIELD_ORTHO20_20_LEFT
    def_bool $(shields_list_contains,ortho20_20_left)
  
config SHIELD_ORTHO20_20_RIGHT
    def_bool $(shields_list_contains,ortho20_20_right)
  
```
